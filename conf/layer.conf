## conf/layer.conf
```bitbake
# We have a conf and classes directory, add to BBPATH
BBPATH .= ":${LAYERDIR}"

# We have recipes-* directories, add to BBFILES
BBFILES += "${LAYERDIR}/recipes-*/*/*.bb \
            ${LAYERDIR}/recipes-*/*/*.bbappend"

BBFILE_COLLECTIONS += "meta-extra"
BBFILE_PATTERN_meta-extra = "^${LAYERDIR}/"
BBFILE_PRIORITY_meta-extra = "6"

LAYERDEPENDS_meta-extra = "core"
LAYERSERIES_COMPAT_meta-extra = "honister"
```
